## components/display/Kconfig
```kconfig
menu "SSD1306"
    config PIN_OLED_SDA
        int
        default 21
        prompt "SDA Pin for OLED display"
    config PIN_OLED_SDL
        int
        default 22
        prompt "SDL Pin for OLED display"
    config PIN_OLED_RESET
        int
        default -1
        prompt "Reset Pin for some OLED displays"
endmenu
```

## components/sx127x_util/Kconfig
```kconfig
menu "SX127X"
    config PIN_CS
        int
        default 18
        prompt "CS pin"
    config PIN_MOSI
        int
        default 27
        prompt "MOSI pin"
    config PIN_MISO
        int
        default 19
        prompt "MISO pin"
    config PIN_SCK
        int
        default 5
        prompt "SCK pin"
    config PIN_DIO0
        int
        default 26
        prompt "DIO0 pin"
    config MIN_FREQUENCY
        int
        default 25000000
        prompt "Minimum frequency"
    config MAX_FREQUENCY
        int
        default 1700000000
        prompt "Maximum frequency"
endmenu
```

## main/Kconfig
```kconfig
menu "AT Handler"
    config AT_UART_PORT_NUM
        int
        default 0
        prompt "UART number. Can be 0,1,2"
    config AT_UART_BAUD_RATE
        int
        default 115200
        prompt "UART baud rate"
    config AT_UART_BUFFER_LENGTH
        int
        default 1024
        prompt "UART buffer for RX and TX"
endmenu
```

## main/Kconfig.projbuild
```kconfig
menu "Lora-AT"
    config AT_UART_PORT_NUM
        int "UART bus to use for AT commands"
        default 0
        help
            ESP32 has several UART buses: 0,1,2. Most likely you need to use default - 0.
    config AT_UART_RX_PIN
        int "RX pin for UART bus"
        default -1
        help
            "-1" mean "use default pin for selected UART_PORT_NUM". Can be re-assigned to any other GPIO pin on the board
    config AT_UART_TX_PIN
        int "TX pin for UART bus"
        default -1
        help
            "-1" mean "use default pin for selected UART_PORT_NUM". Can be re-assigned to any other GPIO pin on the board
    config AT_UART_BAUD_RATE
        int "UART baud rate"
        default 115200
        help
            Baud rate to use for sending and receiving AT commands
    config AT_UART_BUFFER_LENGTH
        int "UART buffer for RX and TX"
        default 1024
    config PIN_CS
        int "CS pin"
        default 18
        help
            CS (Chip Select) or SS (Slave Select) pin for communicating with sx127x chip
    config PIN_MOSI
        int "MOSI pin"
        default 27
        help
            MOSI pin for communicating with sx127x chip
    config PIN_MISO
        int "MISO pin"
        default 19
        help
             MISO pin for communicating with sx127x chip
    config PIN_SCK
        int "SCK pin"
        default 5
        help
            SCK or SCLK pin for communicating with sx127x chip
    config PIN_DIO0
        int "DIO0 pin"
        default 26
        help
             DIO0 (Digital IO) pin for communicating with sx127x chip
    config PIN_DIO1
        int "DIO1 pin"
        default 33
        help
             DIO1 (Digital IO) pin for communicating with sx127x chip. Used in FSK/OOK mode
    config PIN_DIO2
        int "DIO2 pin"
        default 32
        help
             DIO2 (Digital IO) pin for communicating with sx127x chip. Used in FSK/OOK mode
    config PIN_RESET
        int "sx127x reset pin"
        default 23
        help
             Pin to reset sx127x transceiver. The chip will be reset on startup (POWERON_RESET).
             If "-1" then reset won't be performed. However keep in mind that chip might be in the
             unknown state.
    config MIN_FREQUENCY
        int "Minimum frequency"
        default 25000000
        help
            Minimum supported frequency. sx127x chip are normally have tuned for specific ISM frequency band.
    config MAX_FREQUENCY
        int "Maximum frequency"
        default 1700000000
        help
            Minimum supported frequency. sx127x chip are normally have tuned for specific ISM frequency band.
    config PIN_OLED_SDA
        int "SDA Pin for OLED display"
        default 21
        help
            Lora-AT support standard ssd1306 OLED display to show current status
    config PIN_OLED_SDL
        int "SDL Pin for OLED display"
        default 22
        help
            Lora-AT support standard ssd1306 OLED display to show current status
    config PIN_OLED_RESET
        int "Reset Pin for OLED display"
        default -1
        help
            Some boards wire ssd1306 OLED displays so that they have to be reset at the start.
            Configure this pin if display doesn't work out-of-the-box
    config BLUETOOTH_CONNECTION_TIMEOUT
        int "Bluetooth connection timeout"
        default 30000
        help
            Connection timeout while connecting to Bluetooth GATT server
            Used during deep-sleep wake up phase
            The longer timeout the more time device will spend in non-deep sleep mode
            The more energy it will consume
    config BLUETOOTH_RECONNECTION_INTERVAL
        int "Bluetooth reconnection interval"
        default 5000
        help
            Reconnect to bluetooth server while reading next observation
            In millis
    config BLUETOOTH_POWER_PROFILING
        int "Pin for bluetooth power profiling"
        default -1
        help
            Configure digital pin to become high when bluetooth communication initiated
            and become low when completed. Can be used in the Power Profiler Kit II to
            capture periods when bluetooth is active
    config SX127X_POWER_PROFILING
        int "Pin for sx127x power profiling"
        default -1
        help
            Configure digital pin to become high when sx127x communication started
            and become low when completed. Can be used in the Power Profiler Kit II to
            capture periods when sx127x transmitter or receiver is active

    menu "Sensors"
        config SENSORS_ENABLED
            bool "Sensors enabled"
            default n
            help
                Enable INA219 sensors to read battery and solar voltage and current

        config SOLAR_I2C_INA219_ADDR
            hex "I2C address for solar sensor"
            default 0
            help
                If configured, then it will try to connect and read bus voltage and current
                from INA219 sensor. This address is for solar panel sensor. "0" - address is not configured
                INA219 configuration assumes: 0.1 Ohm shunt resistor. Max voltage - 16V
        config BATTERY_I2C_INA219_ADDR
            hex "I2C address for battery sensor"
            default 0
            help
                If configured, then it will try to connect and read bus voltage and current
                from INA219 sensor. This address is for battery sensor. "0" - address is not configured
                INA219 configuration assumes: 0.1 Ohm shunt resistor. Max voltage - 16V
        config I2C_MASTER_SDA
            int "SDA pin"
            default 21
            help
                SDA pin of I2C bus where INA219 sensors attached
        config I2C_MASTER_SCL
            int "SCL pin"
            default 22
            help
                SCL pin of I2C bus where INA219 sensors attached
    endmenu

    menu "Wi-Fi"
        config AT_WIFI_ENABLED
            bool "Wi-Fi enabled"
            default n
            help
                Make lora-at available over Wi-Fi as HTTP REST service
        config ESP_WIFI_SSID
            string "WiFi SSID"
            default "myssid"
            help
                SSID (network name) for the example to connect to.

        config ESP_WIFI_PASSWORD
            string "WiFi Password"
            default "mypassword"
            help
                WiFi password (WPA or WPA2) for the example to use.

        config ESP_MAXIMUM_RETRY
            int "Maximum retry"
            default 5
            help
                Set the Maximum retry to avoid station reconnecting to the AP unlimited when the AP is really inexistent.

        choice ESP_WIFI_SCAN_AUTH_MODE_THRESHOLD
            prompt "WiFi Scan auth mode threshold"
            default ESP_WIFI_AUTH_WPA2_PSK
            help
                The weakest authmode to accept in the scan mode.
                This value defaults to ESP_WIFI_AUTH_WPA2_PSK incase password is present and ESP_WIFI_AUTH_OPEN is used.
                Please select ESP_WIFI_AUTH_WEP/ESP_WIFI_AUTH_WPA_PSK incase AP is operating in WEP/WPA mode.

            config ESP_WIFI_AUTH_OPEN
                bool "OPEN"
            config ESP_WIFI_AUTH_WEP
                bool "WEP"
            config ESP_WIFI_AUTH_WPA_PSK
                bool "WPA PSK"
            config ESP_WIFI_AUTH_WPA2_PSK
                bool "WPA2 PSK"
            config ESP_WIFI_AUTH_WPA_WPA2_PSK
                bool "WPA/WPA2 PSK"
            config ESP_WIFI_AUTH_WPA3_PSK
                bool "WPA3 PSK"
            config ESP_WIFI_AUTH_WPA2_WPA3_PSK
                bool "WPA2/WPA3 PSK"
            config ESP_WIFI_AUTH_WAPI_PSK
                bool "WAPI PSK"
        endchoice

        config MDNS_HOST_NAME
            string "mDNS Host Name"
            default "lora-at"
            help
                Specify the domain name used in the mDNS service.

        config AT_API_USERNAME
            string "REST Service username"
            default "r2lora"
            help
                Username for basic authentication
        config AT_API_PASSWORD
            string "REST Service password"
            default ""
            help
                Password for basic authentication
    endmenu
endmenu
```

## sdkconfig.defaults
```kconfig
#
# Lora-AT
#
CONFIG_AT_UART_PORT_NUM=0
CONFIG_AT_UART_RX_PIN=-1
CONFIG_AT_UART_TX_PIN=-1
CONFIG_AT_UART_BAUD_RATE=115200
CONFIG_AT_UART_BUFFER_LENGTH=1024
CONFIG_PIN_OLED_SDA=21
CONFIG_PIN_OLED_SDL=22
CONFIG_PIN_OLED_RESET=-1
CONFIG_PIN_CS=18
CONFIG_PIN_MOSI=27
CONFIG_PIN_MISO=19
CONFIG_PIN_SCK=5
CONFIG_PIN_DIO0=26
CONFIG_PIN_DIO1=33
CONFIG_PIN_DIO2=32
CONFIG_PIN_RESET=23
CONFIG_MIN_FREQUENCY=25000000
CONFIG_MAX_FREQUENCY=1700000000
CONFIG_BLUETOOTH_CONNECTION_TIMEOUT=30000
CONFIG_BLUETOOTH_RECONNECTION_INTERVAL=5000

#
# Wi-Fi
#
CONFIG_AT_WIFI_ENABLED=n
CONFIG_ESP_WIFI_SSID=""
CONFIG_ESP_WIFI_PASSWORD=""
CONFIG_ESP_MAXIMUM_RETRY=5
CONFIG_ESP_WIFI_AUTH=ESP_WIFI_AUTH_WPA2_PSK
CONFIG_ESP_WIFI_SOFTAP_SUPPORT=n
CONFIG_LWIP_DHCP_GET_NTP_SRV=y
CONFIG_AT_API_USERNAME=""
CONFIG_AT_API_PASSWORD=""

#
# Sensors
#
CONFIG_SENSORS_ENABLED=n
CONFIG_SOLAR_I2C_INA219_ADDR=0
CONFIG_BATTERY_I2C_INA219_ADDR=0
CONFIG_I2C_MASTER_SDA=21
CONFIG_I2C_MASTER_SCL=22

#
# Bluetooth
#
CONFIG_BT_ENABLED=y
CONFIG_BT_NIMBLE_ENABLED=y
CONFIG_BT_CONTROLLER_ENABLED=y

#
# Power profiling
#
CONFIG_BLUETOOTH_POWER_PROFILING=-1
CONFIG_SX127X_POWER_PROFILING=-1

#
# Bootloader
#
CONFIG_BOOTLOADER_SKIP_VALIDATE_IN_DEEP_SLEEP=y
CONFIG_BOOTLOADER_LOG_LEVEL=1
CONFIG_BOOTLOADER_LOG_LEVEL_ERROR=y
CONFIG_BOOTLOADER_COMPILER_OPTIMIZATION_PERF=y

#
# ESP System Settings
#
CONFIG_ESP_DEFAULT_CPU_FREQ_MHZ_80=y
CONFIG_ESP_DEFAULT_CPU_FREQ_MHZ=80

#
# Log output
#
CONFIG_LOG_DEFAULT_LEVEL_ERROR=y
CONFIG_LOG_DEFAULT_LEVEL=1
CONFIG_LOG_MAXIMUM_LEVEL_INFO=y
CONFIG_LOG_MAXIMUM_LEVEL=3

#
# Compiler
#
CONFIG_COMPILER_OPTIMIZATION_PERF=y
```

## test/sdkconfig.defaults
```kconfig
CONFIG_ESP_TASK_WDT=n
CONFIG_HEAP_POISONING_DISABLED=y
CONFIG_HEAP_TRACING_STANDALONE=y
CONFIG_HEAP_TRACING=y
CONFIG_HEAP_TRACING_STACK_DEPTH=2


#
# Lora-AT
#
CONFIG_AT_UART_PORT_NUM=0
CONFIG_AT_UART_BAUD_RATE=115200
CONFIG_AT_UART_BUFFER_LENGTH=1024
CONFIG_PIN_OLED_SDA=21
CONFIG_PIN_OLED_SDL=22
CONFIG_PIN_OLED_RESET=-1
CONFIG_PIN_CS=18
CONFIG_PIN_MOSI=27
CONFIG_PIN_MISO=19
CONFIG_PIN_SCK=5
CONFIG_PIN_DIO0=26
CONFIG_MIN_FREQUENCY=25000000
CONFIG_MAX_FREQUENCY=1700000000
CONFIG_BLUETOOTH_CONNECTION_TIMEOUT=30000
# end of Lora-AT

#
# Bluetooth
#
CONFIG_BT_ENABLED=y
CONFIG_BT_NIMBLE_ENABLED=y
CONFIG_BT_CONTROLLER_ENABLED=y
```
